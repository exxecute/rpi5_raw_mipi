// Fragment that configures an virtual raw camera with 4 mipi lines

cam_node: raw_mipi@10 {
	compatible = "raw,4-line";
	reg = <0x10>;
	status = "disabled";

	clocks = <&cam1_clk>;
	clock-names = "xclk";

	VANA-supply = <&cam1_reg>;	/* 2.8v */
	VDIG-supply = <&cam_dummy_reg>;	/* 1.8v */
	VDDL-supply = <&cam_dummy_reg>;	/* 1.2v */

	rotation = <180>;
	orientation = <2>;

	port {
		cam_endpoint: endpoint {
			clock-lanes = <0>;
			data-lanes = <1 2 3 4>;
			clock-noncontinuous;
			link-frequencies =
				/bits/ 64 <200000000>;
		};
	};
};
